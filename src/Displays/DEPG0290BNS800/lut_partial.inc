/* 
    File: lut_partial.inc

        - Lookup table for E-ink display
            Model: DEPG0290BNS800
            Refresh: Partial

            Source: Custom (Referencng Heltec DEPG0150BNS810)

            1. Tap existing black pixels into place - helps when initially moving into fastmode
            2. Move new pixels into place - long
            3. New pixels + old black pixels - short
            4. All pixels together - v. short, then cooldown (crucial!)

            Last adjusted: 2024-8-10
*/

0x40, 0x00, 0x40, 0x40, 0x00, 0x00, 0x00, 0x00, 0x00, 0x00, 0x00, 0x00, // B2B
0x00, 0x80, 0x80, 0x80, 0x00, 0x00, 0x00, 0x00, 0x00, 0x00, 0x00, 0x00, // B2W
0x00, 0x40, 0x40, 0x40, 0x00, 0x00, 0x00, 0x00, 0x00, 0x00, 0x00, 0x00, // W2B
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0x22, 0x22, 0x22, 0x22, 0x22, 0x22, 0x00, 0x00, 0x00
