/* 
    File: lut_partial.inc

        - Lookup table for E-ink display
            Model: DEPG0213BNS800
            Refresh: Partial

            Source: GxEPD2 (unmodified) - thank you!
            https://github.com/ZinggJM/GxEPD2/blob/220fc5845c08b83c8dbac63e0cb83e1a774071ca/src/epd/GxEPD2_213_BN.cpp#L365
*/

0x00, 0x40, 0x00, 0x00, 0x00, 0x00, 0x00, 0x00, 0x00, 0x00, 0x00, 0x00,
0x80, 0x80, 0x00, 0x00, 0x00, 0x00, 0x00, 0x00, 0x00, 0x00, 0x00, 0x00,
0x40, 0x40, 0x00, 0x00, 0x00, 0x00, 0x00, 0x00, 0x00, 0x00, 0x00, 0x00,
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0x22, 0x22, 0x22, 0x22, 0x22, 0x22, 0x00, 0x00, 0x00