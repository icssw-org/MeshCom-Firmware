/* 
    File: lut_partial.inc

        - Lookup table for E-ink display
            Model: DEPG0150BNS810
            Refresh: Partial

            Source: Heltec (unmodified)
            https://github.com/HelTecAutomation/Wireless-Paper/blob/ac5e7004309d9384c098e494d613f77c882d1d3c/src/DEPG0150BxS810FxX_BW.h#L18

            Last adjusted: 2024-2-27
*/

0x00, 0x40, 0x00, 0x00, 0x00, 0x00, 0x00, 0x00, 0x00, 0x00, 0x00, 0x00,     // B2B
0x80, 0x80, 0x00, 0x00, 0x00, 0x00, 0x00, 0x00, 0x00, 0x00, 0x00, 0x00,     // B2W
0x40, 0x40, 0x00, 0x00, 0x00, 0x00, 0x00, 0x00, 0x00, 0x00, 0x00, 0x00,     // W2B
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0x22, 0x22, 0x22, 0x22, 0x22, 0x22, 0x00, 0x00, 0x00 